## CMakeLists.txt
```
# SPDX-License-Identifier: Apache-2.0
#
# CANopen (v4) Zephyr sample - 最小 CANopen 节点.
#
# 用 devicetree chosen(zephyr_canbus) 指向的 CAN 设备 + 默认 OD (v4 example/OD).
# 应用层调 canopennode_init() + 周期调 canopennode_process().
#
# Build:
#   west build -b <board_with_can> samples/canopen
# Run (native_sim):
#   west build -b native_sim samples/canopen
#   build/zephyr/zephyr.exe  (需先 setup vcan + DT 配置 canbus=node)

cmake_minimum_required(VERSION 3.20.0)

find_package(Zephyr REQUIRED HINTS $ENV{ZEPHYR_BASE})
project(canopen_sample)

target_sources(app PRIVATE
    src/main.c
    objdict/OD.c
)

zephyr_include_directories(objdict)
```

## sample.yaml
```
# SPDX-License-Identifier: Apache-2.0

sample:
  name: CANopenNode v4 Zephyr sample
  description: Minimal CANopen node using the CANopenNode v4 stack
  platform_allow: native_sim
  integration_platforms:
    - native_sim
  harness: console
  harness_config:
    type: one_line
    regex:
      - "CANopen \\(v4\\) sample started"
  tags: can canopen
```

## prj.conf
```kconfig
# SPDX-License-Identifier: Apache-2.0
#
# CANopen (v4) sample 配置 - 完整功能.
#
# CAN 配置:
#   - 通过 devicetree chosen(zephyr_canbus) 选定 CAN 设备
#   - 板级 overlay 提供 chosen 节点 + bitrate
#
# native_sim 快速验证 (Linux, 需 vcan):
#   sudo modprobe vcan && sudo ip link add dev vcan0 type vcan && sudo ip link set vcan0 up
#   west build -b native_sim -d build/native samples/canopen \
#       -DDTC_OVERLAY_FILE=boards/native_sim.overlay
#   ./build/native/zephyr/zephyr.exe

# ===== CANopenNode v4 module =====
CONFIG_CANOPENNODE=y
CONFIG_CANOPEN_NODE_ID=10
CONFIG_CANOPENNODE_LOG_LEVEL_INF=y

# ===== 完整功能模块 =====
# CiA 305 LSS (节点 ID/波特率在线配置)
CONFIG_CANOPENNODE_LSS=y
# SDO 客户端 (master 功能)
CONFIG_CANOPENNODE_SDO_CLIENT=y
# CiA 309-3 ASCII 网关
CONFIG_CANOPENNODE_GATEWAY_ASCII=n
# OD 持久化 (Zephyr settings)
CONFIG_CANOPENNODE_STORAGE=y
# LED 指示 (CiA 303-3)
CONFIG_CANOPENNODE_LEDS=y
# SYNC 线程
CONFIG_CANOPENNODE_SYNC_THREAD=y

# ===== CAN =====
CONFIG_CAN=y
CONFIG_CAN_DEFAULT_BITRATE=250000

# ===== 日志 =====
CONFIG_LOG=y
CONFIG_PRINTK=y

# ===== 运行时设置 (storage 需要) =====
CONFIG_SETTINGS=y
```

## boards/native_sim.overlay
```dts
/*
 * Copyright (c) 2026 Kabirz.
 * SPDX-License-Identifier: Apache-2.0
 *
 * native_sim CANopen overlay: 把 zephyr_canbus 指向 native_sim 的 can0 (socketcan).
 *
 * 使用 (Linux, 需 vcan + altname):
 *   sudo modprobe vcan
 *   sudo ip link add dev vcan0 type vcan
 *   sudo ip link property add dev vcan0 altname zcan0
 *   sudo ip link set vcan0 up
 *   west build -b native_sim -d build/native samples/canopen \
 *       -DDTC_OVERLAY_FILE=boards/native_sim.overlay
 *   ./build/native/zephyr/zephyr.exe
 *
 * 然后用 cansend/candump (can-utils) 从另一侧交互:
 *   candump zcan0
 *   cansend zcan0 000#    (NMT 启动)
 */

/ {
	chosen {
		zephyr_canbus = &can0;
	};
};

&can0 {
	status = "okay";
};
```

## boards/stm32f407.overlay
```dts
/*
 * Copyright (c) 2026 Kabirz.
 * SPDX-License-Identifier: Apache-2.0
 *
 * STM32F407 CANopen overlay 示例: 把 zephyr_canbus 指向 CAN1.
 *
 * 用法 (io_edge_f407vet6 或任意 stm32f4 板):
 *   west build -b io_edge_f407vet6 -d build/stm32 samples/canopen \
 *       -DDTC_OVERLAY_FILE=boards/stm32f407.overlay
 *
 * 引脚 (STM32F407VET6): CAN1_TX=PA12, CAN1_RX=PA11
 */

/ {
	chosen {
		zephyr_canbus = &can1;
	};
};

&can1 {
	status = "okay";
	bitrate = <250000>;
};
```

## src/main.c
```c
/*
 * Copyright (c) 2026 Kabirz.
 * SPDX-License-Identifier: Apache-2.0
 *
 * CANopen (v4) Zephyr sample - 完整 CANopen 节点.
 *
 * 流程:
 *   1. canopennode_init()       - 协议栈初始化 (CAN 收发已由 CO_driver 完成)
 *   2. storage / leds / sync    - 可选模块
 *   3. main 循环: canopennode_process() 周期驱动
 *   4. CO_RESET_COMM/APP 处理
 *
 * 设备树要求:
 *   chosen { zephyr_canbus = &can1; };
 *   可选 aliases: green_led / red_led (CiA 303-3 指示)
 */

#include <zephyr/kernel.h>
#include <zephyr/device.h>
#include <zephyr/logging/log.h>

#include "canopennode.h"
#include "OD.h"

#if defined(CONFIG_CANOPENNODE_STORAGE)
#include "storage/CO_storage.h"
#include "canopen_storage.h"
#endif

#if defined(CONFIG_CANOPENNODE_LEDS)
#include "303/CO_LEDs.h"
#include "canopen_leds.h"
#endif

#if defined(CONFIG_CANOPENNODE_SYNC_THREAD)
#include "canopen_sync_thread.h"
#endif

LOG_MODULE_REGISTER(app, LOG_LEVEL_INF);

#define MAIN_THREAD_SLEEP_US 1000   /* 1ms 主循环 */
#define CANOPEN_NODE_ID      CONFIG_CANOPEN_NODE_ID
#define CANOPEN_BITRATE_KBPS 250

int main(void)
{
	int rc;
	CO_NMT_reset_cmd_t reset;

	LOG_INF("CANopen (v4) sample started, node_id=%d", CANOPEN_NODE_ID);

#if defined(CONFIG_CANOPENNODE_STORAGE)
	CO_storage_t storage;
	CO_storage_entry_t storage_entries[] = {
		{ .addr = &OD_PERSIST_COMM, .len = sizeof(OD_PERSIST_COMM),
		  .subIndexOD = 2, .attr = CO_storage_cmd | CO_storage_restore,
		  .addrNV = NULL },
	};
	uint32_t storage_init_error = 0;
#endif

#if defined(CONFIG_CANOPENNODE_LEDS)
	CO_LEDs_t leds;
#endif

	while (1) {
		rc = canopennode_init(CANOPEN_NODE_ID, CANOPEN_BITRATE_KBPS);
		if (rc != 0) {
			LOG_ERR("canopennode_init failed: %d, retry in 1s", rc);
			k_sleep(K_SECONDS(1));
			continue;
		}

#if defined(CONFIG_CANOPENNODE_STORAGE)
		rc = canopen_storage_init(&storage, CO->CANmodule, OD,
					  storage_entries,
					  ARRAY_SIZE(storage_entries),
					  &storage_init_error);
		if (rc != 0) {
			LOG_WRN("storage init failed: %d", rc);
		}
#endif

#if defined(CONFIG_CANOPENNODE_LEDS)
		if (canopen_leds_init(&leds) != 0) {
			LOG_WRN("LED init failed (ignored)");
		}
#endif

#if defined(CONFIG_CANOPENNODE_SYNC_THREAD)
		canopen_sync_start(CO);
#endif

		/* 通信循环 */
		reset = CO_RESET_NOT;
		while (reset == CO_RESET_NOT) {
			reset = canopennode_process(MAIN_THREAD_SLEEP_US);
			k_sleep(K_USEC(MAIN_THREAD_SLEEP_US));
		}

		LOG_INF("CANopen reset: %s",
			reset == CO_RESET_COMM ? "COMM" : "APP");
		canopennode_shutdown();
	}

	return 0;
}
```
